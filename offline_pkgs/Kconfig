## offline_pkgs/Kconfig
```kconfig
menu "RT-Thread offline packages"

menuconfig OFFLINE_PKG_USING_MULTIBUTTON
	bool "Enable Multibutton package"
    default n
    if OFFLINE_PKG_USING_MULTIBUTTON
        config MULTIBUTTON_USING_EXAMPLE_CALLBACK
            bool "Enable async example"
            default n
        config MULTIBUTTON_USING_EXAMPLE_POLL
            bool "Enable inquire example"
            default n
    endif

endmenu
```

## stm32f411ceu6/board/Kconfig
```kconfig
menu "Hardware Drivers Config"

config SOC_STM32F411CE
    bool
    select SOC_SERIES_STM32F4
    select RT_USING_COMPONENTS_INIT
    select RT_USING_USER_MAIN
    default y

menu "Onboard Peripheral Drivers"

	config BSP_USING_SPI_FLASH
        bool "Enable SPI FLASH (W25Q64 spi1)"
        select BSP_USING_SPI
        select BSP_USING_SPI1
        select RT_USING_SFUD
        select RT_SFUD_USING_SFDP
        default n
		
	config BSP_USING_FAL
        bool "Enable FAL (enable on-chip flash and spi1 flash)"
        select BSP_USING_SPI_FLASH
        select BSP_USING_ON_CHIP_FLASH
        select RT_USING_FAL
        select FAL_DEBUG_CONFIG
        select FAL_PART_HAS_TABLE_CFG
        select FAL_USING_SFUD_PORT
		default n
		
	if BSP_USING_FAL
		menuconfig BSP_USING_BOOTLOADER
		bool "Enable bootloader partition table"
		default n
	endif
	
endmenu

menu "On-chip Peripheral Drivers"

    config BSP_USING_GPIO
        bool "Enable GPIO"
        select RT_USING_PIN
        default y

    menuconfig BSP_USING_UART
        bool "Enable UART"
        default y
        select RT_USING_SERIAL
        if BSP_USING_UART
            config BSP_USING_UART1
                bool "Enable UART1"
                default y

            config BSP_UART1_RX_USING_DMA
                bool "Enable UART1 RX DMA"
                depends on BSP_USING_UART1 && RT_SERIAL_USING_DMA
                default n
        endif
	
	config BSP_USING_ON_CHIP_FLASH
        bool "Enable on-chip FLASH"
        default n
		
	menuconfig BSP_USING_SPI
        bool "Enable SPI BUS"
        default n
        select RT_USING_SPI
        if BSP_USING_SPI
            config BSP_USING_SPI1
                bool "Enable SPI1 BUS"
                default n

            config BSP_SPI1_TX_USING_DMA
                bool "Enable SPI1 TX DMA"
                depends on BSP_USING_SPI1
                default n
                
            config BSP_SPI1_RX_USING_DMA
                bool "Enable SPI1 RX DMA"
                depends on BSP_USING_SPI1
                select BSP_SPI1_TX_USING_DMA
                default n
        endif

    source "$RTT_DIR/../libraries/HAL_Drivers/Kconfig"

endmenu

menu "Board extended module Drivers"

endmenu

endmenu
```
